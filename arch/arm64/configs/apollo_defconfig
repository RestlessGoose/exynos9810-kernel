## arch/arm64/configs/apollo_defconfig
```kconfig
#
#
# Apollo Defconfig
#
#
CONFIG_BOEFFLA_WL_BLOCKER=y
CONFIG_CUSTOM_FORCETOUCH=y
CONFIG_SEC_INPUT_BOOSTER=y
CONFIG_ARGOS=y
CONFIG_ARGOS_CLUSTER_NUM=2
CONFIG_PROC_AVC=y
CONFIG_PAGE_BOOST=y
CONFIG_PAGE_BOOST_RECORDING=y
CONFIG_PROCESS_RECLAIM=y
CONFIG_INCREASE_MAXIMUM_SWAPPINESS=y
CONFIG_KSWAPD_CPU=0x3F

#
# MoroSound
#
CONFIG_MORO_SOUND=y

#
# Flar2 Wake Gestures
#
CONFIG_WAKE_GESTURES=y

#
# Wireguard
#
CONFIG_WIREGUARD=y
# CONFIG_WIREGUARD_DEBUG is not set

#
# IKHEADERS
#
CONFIG_IKHEADERS=y

# Enable power efficient workqueues

#
# Incremental Filesystem
#
CONFIG_INCREMENTAL_FS=y

# Brightness mod for OneUI7

# CONFIG_ONEUI7_WORKAROUND is not set

# CrownTrail Features

CONFIG_ICE=y
CONFIG_POWER_ENVELOPE=y
CONFIG_BOOST_LIMITER=y

CONFIG_LRU_GEN=y
CONFIG_LRU_GEN_STATS=y
CONFIG_LRU_GEN_ENABLED=y
```
